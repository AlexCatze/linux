## arch/arm/mach-pxa/loox720/Kconfig
```kconfig
menu "Fujitsu-Siemens PocketLoox 720 configuration"
    depends on MACH_LOOX720

config LOOX720_PCMCIA
    tristate 'FSC Loox 720 CF/PC Card'
    depends on MACH_LOOX720 
    select PCCARD
    select PCMCIA_PXA2XX
    default m
    help
        Enable CF/PC Card controller in Loox 720. This must be set to Y if you
        want to boot from CF card, but this also turns WiFi chip on.

config LOOX720_FLASH
    tristate "FSC Loox 720 Flash ROM"
    select MTD
    select MTD_CFI
    select MTD_PARTITIONS
    select MTD_CFI_INTELEXT
    select MTD_PXA2XX
    depends on MACH_LOOX720
    help
        FSC Loox 720 internal flash ROM support.

config DRAM_BASE
    hex '(S)DRAM Base Address'
    depends on MACH_LOOX720
    default 0xa8200000
    help
        RAM base address passed to the kernel. Skips the first 2MB of
        physical RAM (0xa8000000-0xa81fffff) used by the WinCE bootloader
        (HaRET). Required for 2.6.36+ due to the ARM memblock allocator.
        If you use Haret prior to 0.4.9, set this to 0xaa000000 and
        change DRAM Size accordingly.

config DRAM_SIZE
    hex '(S)DRAM Size'
    depends on MACH_LOOX720
    default 0x7e00000
    help
        RAM size in bytes. Default is 126MB (128MB minus the 2MB skipped
        at the start for the WinCE bootloader region). If you use Haret
        prior to 0.4.9, set this to 0x6000000 and change DRAM Base.

endmenu
```
